## Kconfig
```kconfig
#
# VFI configuration
#

menu "Vmetro FusionIPC Distributed DMA driver support"

config VFI
	tristate "Vmetro FusionIPC Distributed DMA driver"
	default m
	---help---
	  Enable support for the Vmetro FusionIPC Distributed DMA engine.

config VFI_FABRIC_NET
	tristate "FusionIPC Distributed DMA driver -- use ethernet in place of switch fabric"
	depends on VFI && NET
	default m
	---help---
	  Enable support for using the ethernet for VFI as if
	  it were a switch fabric.

config VFI_DMA_NET
	tristate "FusionIPC Distributed DMA driver dummy"
	depends on VFI && NET
	default m
	---help---
	  Enable support for FusionIPC Distributed DMA over ethernet for debug
	  simulation purposes. Doesn't support actual DMA of data only the
	  messaging to set it up.

config VFI_FABRIC_RIONET
	tristate "FusionIPC Distributed DMA driver -- RIO switch fabric"
	depends on VFI && RIONET
	default m
	---help---
	  Enable support for VFI communication over RIO switch fabric

config VFI_DMA_RIO
	tristate "FusionIPC Distributed DMA driver -- RIO via PPC8641 DMA hardware"
	depends on VFI && RAPIDIO
	default m
	---help---
	  Enable support for FusionIPC Distributed DMA over Rapid I/O.

config VFI_DMA_6460
	tristate "FusionIPC Distributed DMA driver -- VFI on MPC8245 (MPC10x DMA controller)"
	depends on VFI && MPC10X_BRIDGE
	default m
	---help---
	  Enable support for FusionIPC Distributed DMA over Rapid I/O.

config VFI_DEBUG
	bool "VFI debugging"
	depends on VFI
	default n
	---help---
	  Enable debug of the VFI.

config VFI_KOBJ_DEBUG
	bool "VFI kobject debugging"
	depends on VFI
	default n
	---help---
	  Enable additional debug traces that track kobject/kset refcount changes
	  as they occur, and that provide some context to where they occur.

	  This feature produces a wheen of otherwise-useless messages in the system
	  log, so should be DISABLED by DEFAULT, and used only when you're trying to
	  find leaks in VFI put/get refcounting.

	  Use an expression like the one below to extract these messages out of a log:
	  
	  	grep -P "kobject_|kset_|\\*\\*\\*\\>"
endmenu
```
